## firmware/main/Kconfig
```kconfig
# rig-lookout 固件配置（P2a 骨架）
menu "Rig Lookout"

    config RK_TZ_OFFSET_MIN
        int "本地时区偏移（分钟，东半球为正；中国=480）"
        range -840 840
        default 480
        help
            快照 ts（UTC 秒）→ 「最后在线 HH:MM」与底栏时钟的仅显示换算，
            不参与任何状态判断。模拟器用固定字符串（确定性）。

endmenu
```
